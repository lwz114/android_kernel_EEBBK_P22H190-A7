## drivers/input/touchscreen/nt36xxx/Kconfig
```kconfig
config TOUCHSCREEN_NT36XXX
    tristate "Novatek NT36xxx I2C touchscreen"
    depends on I2C
    help
      Say Y here if you have a Novatek NT36xxx I2C touchscreen.
```

## drivers/misc/gxcodec/Kconfig
```kconfig
config GXCODEC
	bool "NationalChip GX8002 voice codec"
	depends on I2C && SPI_MASTER && GPIOLIB
	help
	  Enable the NationalChip GX8002 companion voice codec used by
	  the BBK A3 audio capture path.
```
